
/* DO NOT EDIT!  This is an autogenerated file.  See tools/layoutrom.py. */
OUTPUT_FORMAT("elf32-i386")
OUTPUT_ARCH("i386")
SECTIONS
{
e820_count = 0xfcd80 ;
e820_list = 0xfcd84 ;
cpu_khz = 0xfd268 ;
irq_trampoline_0x10 = 0xfc783 ;
irq_trampoline_0x16 = 0xfc78c ;
trampoline_waitirq = 0xfe983 ;
smp_mtrr_count = 0xfd0e0 ;
smp_mtrr = 0xfd0e4 ;
bounce_buf_fl = 0xfd2c8 ;
MaxPCIBus = 0xfd26c ;
FloppyInfo = 0xfd270 ;
keyboard_pipe = 0xfd008 ;
mouse_pipe = 0xfd004 ;
MaxCountCPUs = 0xfd0d8 ;
CountCPUs = 0xfd0dc ;
RamSize = 0xfdbf0 ;
FloppyCount = 0xfd38c ;
IDMap = 0xfd2cc ;
entry_iret_official = 0xfff53 ;
entry_hwpic1 = 0xfc96e ;
entry_hwpic2 = 0xfe2ba ;
entry_02 = 0xfe2c3 ;
entry_10 = 0xff065 ;
entry_11 = 0xff84d ;
entry_12 = 0xff841 ;
entry_13_official = 0xfe3fe ;
entry_14 = 0xfe739 ;
entry_15 = 0xff859 ;
entry_16 = 0xfe82e ;
entry_17 = 0xfefd2 ;
entry_18 = 0xfc98a ;
entry_19_official = 0xfe6f2 ;
entry_1a = 0xffe6e ;
entry_40 = 0xfec59 ;
diskette_param_table2 = 0xfd2b8 ;
entry_08 = 0xffea5 ;
entry_70 = 0xfc953 ;
entry_75 = 0xfc965 ;
smp_ap_boot_code = 0xff06e ;
BIOS32HEADER = 0xfd010 ;
entry_bios32 = 0xfc8cb ;
PMMHEADER = 0xfd390 ;
entry_pmm = 0xfc7a9 ;
entry_pnp_real = 0xfc7f6 ;
PNPHEADER = 0xfd0b0 ;
entry_pnp_prot = 0xfc7f2 ;
PIR_TABLE = 0xfd020 ;
PirOffset = 0xfd0a0 ;
entry_09 = 0xfe987 ;
entry_74 = 0xfc95c ;
entry_0e = 0xfef57 ;
entry_76 = 0xfc94a ;
cdemu_drive_gf = 0xfd264 ;
BiosChecksum = 0xfffff ;
HaveRunPost = 0xfd0d4 ;
BiosTableSpace = 0xfd3f0 ;
__call16big_from32 = 0xfc769 ;
trampoline_checkirqs = 0xfe82b ;
__call16_from32 = 0xfc75f ;
irq_trampoline_0x13 = 0xfc786 ;
irq_trampoline_0x18 = 0xfc78f ;
irq_trampoline_0x19 = 0xfef52 ;

    entry_elf = 0xfc8ea ;
    _reloc_min_align = 0x10 ;
    code32flat_start = 0xe358c ;
    .text code32flat_start : {
        _reloc_abs_start = ABSOLUTE(.) ;
LONG(0xe3eef - code32init_start)
LONG(0xe3f4c - code32init_start)
LONG(0xe3f53 - code32init_start)
LONG(0xe42d3 - code32init_start)
LONG(0xe45bc - code32init_start)
LONG(0xe45cb - code32init_start)
LONG(0xe45ea - code32init_start)
LONG(0xe462d - code32init_start)
LONG(0xe473c - code32init_start)
LONG(0xe4744 - code32init_start)
LONG(0xe477c - code32init_start)
LONG(0xe4784 - code32init_start)
LONG(0xe47b1 - code32init_start)
LONG(0xe4814 - code32init_start)
LONG(0xe4bda - code32init_start)
LONG(0xe4c4c - code32init_start)
LONG(0xe4cf4 - code32init_start)
LONG(0xe4e67 - code32init_start)
LONG(0xe4f3a - code32init_start)
LONG(0xe4f6a - code32init_start)
LONG(0xe51c8 - code32init_start)
LONG(0xe51ce - code32init_start)
LONG(0xe5284 - code32init_start)
LONG(0xe528b - code32init_start)
LONG(0xe52c0 - code32init_start)
LONG(0xe532c - code32init_start)
LONG(0xe538b - code32init_start)
LONG(0xe5412 - code32init_start)
LONG(0xe5419 - code32init_start)
LONG(0xe5475 - code32init_start)
LONG(0xe5495 - code32init_start)
LONG(0xe54bd - code32init_start)
LONG(0xe5529 - code32init_start)
LONG(0xe554b - code32init_start)
LONG(0xe5585 - code32init_start)
LONG(0xe5591 - code32init_start)
LONG(0xe5693 - code32init_start)
LONG(0xe56ac - code32init_start)
LONG(0xe56e6 - code32init_start)
LONG(0xe56fc - code32init_start)
LONG(0xe5716 - code32init_start)
LONG(0xe5730 - code32init_start)
LONG(0xe5767 - code32init_start)
LONG(0xe57c7 - code32init_start)
LONG(0xe5817 - code32init_start)
LONG(0xe582b - code32init_start)
LONG(0xe588b - code32init_start)
LONG(0xe58d0 - code32init_start)
LONG(0xe5901 - code32init_start)
LONG(0xe591b - code32init_start)
LONG(0xe5a34 - code32init_start)
LONG(0xe5d6b - code32init_start)
LONG(0xe5f1a - code32init_start)
LONG(0xe5f76 - code32init_start)
LONG(0xe60a0 - code32init_start)
LONG(0xe6115 - code32init_start)
LONG(0xe62e5 - code32init_start)
LONG(0xe62ee - code32init_start)
LONG(0xe62fb - code32init_start)
LONG(0xe6304 - code32init_start)
LONG(0xe637a - code32init_start)
LONG(0xe639c - code32init_start)
LONG(0xe6b7e - code32init_start)
LONG(0xe6bbe - code32init_start)
LONG(0xe6e36 - code32init_start)
LONG(0xe6e6e - code32init_start)
LONG(0xe6ed0 - code32init_start)
LONG(0xe6f45 - code32init_start)
LONG(0xe6fcc - code32init_start)
LONG(0xe701e - code32init_start)
LONG(0xe7090 - code32init_start)
LONG(0xe7114 - code32init_start)
LONG(0xe7175 - code32init_start)
LONG(0xe724f - code32init_start)
LONG(0xe7302 - code32init_start)
LONG(0xe73b6 - code32init_start)
LONG(0xe7440 - code32init_start)
LONG(0xe74ea - code32init_start)
LONG(0xe75ac - code32init_start)
LONG(0xe7609 - code32init_start)
LONG(0xe760f - code32init_start)
LONG(0xe7620 - code32init_start)
LONG(0xe7664 - code32init_start)
LONG(0xe76bd - code32init_start)
LONG(0xe76e8 - code32init_start)
LONG(0xe770d - code32init_start)
LONG(0xe7714 - code32init_start)
LONG(0xe7763 - code32init_start)
LONG(0xe7788 - code32init_start)
LONG(0xe7803 - code32init_start)
LONG(0xe7816 - code32init_start)
LONG(0xe785d - code32init_start)
LONG(0xe7874 - code32init_start)
LONG(0xe789d - code32init_start)
LONG(0xe78d6 - code32init_start)
LONG(0xe78e7 - code32init_start)
LONG(0xe78f1 - code32init_start)
LONG(0xe794a - code32init_start)
LONG(0xe7aad - code32init_start)
LONG(0xe7b5e - code32init_start)
LONG(0xe7b8e - code32init_start)
LONG(0xe7c18 - code32init_start)
LONG(0xe7df3 - code32init_start)
LONG(0xe7e55 - code32init_start)
LONG(0xe7e61 - code32init_start)
LONG(0xe7e79 - code32init_start)
LONG(0xe7ea0 - code32init_start)
LONG(0xe7f93 - code32init_start)
LONG(0xe8243 - code32init_start)
LONG(0xe82f0 - code32init_start)
LONG(0xe8334 - code32init_start)
LONG(0xe865e - code32init_start)
LONG(0xe8748 - code32init_start)
LONG(0xe8848 - code32init_start)
LONG(0xe89c9 - code32init_start)
LONG(0xe8a4e - code32init_start)
LONG(0xe8a8a - code32init_start)
LONG(0xe8b91 - code32init_start)
LONG(0xe8bd4 - code32init_start)
LONG(0xe8c54 - code32init_start)
LONG(0xe8c6a - code32init_start)
LONG(0xe8d60 - code32init_start)
LONG(0xe8f27 - code32init_start)
LONG(0xe9150 - code32init_start)
LONG(0xe93ed - code32init_start)
LONG(0xe94b3 - code32init_start)
LONG(0xe96ba - code32init_start)
LONG(0xe9aab - code32init_start)
LONG(0xe9e86 - code32init_start)
LONG(0xea02c - code32init_start)
LONG(0xea048 - code32init_start)
LONG(0xea522 - code32init_start)
LONG(0xea5b7 - code32init_start)
LONG(0xeab27 - code32init_start)
LONG(0xeab77 - code32init_start)
LONG(0xeaba5 - code32init_start)
LONG(0xeac1d - code32init_start)
LONG(0xeac84 - code32init_start)
LONG(0xeaccd - code32init_start)
LONG(0xeae25 - code32init_start)
LONG(0xeaea8 - code32init_start)
LONG(0xeaf99 - code32init_start)
LONG(0xeb03d - code32init_start)
LONG(0xeb082 - code32init_start)
LONG(0xeb0a9 - code32init_start)
LONG(0xeb0cf - code32init_start)
LONG(0xeb30c - code32init_start)
LONG(0xeb311 - code32init_start)
LONG(0xeb317 - code32init_start)
LONG(0xeb332 - code32init_start)
LONG(0xeb35f - code32init_start)
LONG(0xeb385 - code32init_start)
LONG(0xeb38b - code32init_start)
LONG(0xeb3a3 - code32init_start)
LONG(0xeb441 - code32init_start)
LONG(0xeb447 - code32init_start)
LONG(0xeb4e2 - code32init_start)
LONG(0xeb4e8 - code32init_start)
LONG(0xeb536 - code32init_start)
LONG(0xeb53c - code32init_start)
LONG(0xeb546 - code32init_start)
LONG(0xeb565 - code32init_start)
LONG(0xeb613 - code32init_start)
LONG(0xeb62a - code32init_start)
LONG(0xeb7bd - code32init_start)
LONG(0xeb8bf - code32init_start)
LONG(0xeb917 - code32init_start)
LONG(0xeb944 - code32init_start)
LONG(0xeb975 - code32init_start)
LONG(0xeb9c2 - code32init_start)
LONG(0xeba37 - code32init_start)
LONG(0xebae8 - code32init_start)
LONG(0xebb06 - code32init_start)
LONG(0xebb25 - code32init_start)
LONG(0xebbf9 - code32init_start)
LONG(0xec006 - code32init_start)
LONG(0xec1dc - code32init_start)
LONG(0xed23c - code32init_start)
LONG(0xed288 - code32init_start)
LONG(0xed291 - code32init_start)
LONG(0xed2c8 - code32init_start)
LONG(0xed328 - code32init_start)
LONG(0xed32d - code32init_start)
LONG(0xed342 - code32init_start)
LONG(0xed34b - code32init_start)
LONG(0xed35d - code32init_start)
LONG(0xed720 - code32init_start)
LONG(0xed834 - code32init_start)
LONG(0xed839 - code32init_start)
LONG(0xed843 - code32init_start)
LONG(0xed848 - code32init_start)
LONG(0xed917 - code32init_start)
LONG(0xed95e - code32init_start)
LONG(0xed995 - code32init_start)
LONG(0xedf84 - code32init_start)
LONG(0xedfa7 - code32init_start)
LONG(0xedfb5 - code32init_start)
LONG(0xedfbb - code32init_start)
LONG(0xedfd6 - code32init_start)
LONG(0xee08c - code32init_start)
LONG(0xee0ea - code32init_start)
LONG(0xee123 - code32init_start)
LONG(0xee138 - code32init_start)
LONG(0xee159 - code32init_start)
LONG(0xee16a - code32init_start)
LONG(0xee175 - code32init_start)
LONG(0xee218 - code32init_start)
LONG(0xee21e - code32init_start)
LONG(0xee224 - code32init_start)
LONG(0xee22a - code32init_start)
LONG(0xee25c - code32init_start)
LONG(0xee269 - code32init_start)
LONG(0xee274 - code32init_start)
LONG(0xee28b - code32init_start)
LONG(0xee36b - code32init_start)
LONG(0xee3bc - code32init_start)
LONG(0xee522 - code32init_start)
LONG(0xee81f - code32init_start)
LONG(0xee8f4 - code32init_start)
LONG(0xee993 - code32init_start)
LONG(0xeef02 - code32init_start)
LONG(0xeef08 - code32init_start)
LONG(0xef0d2 - code32init_start)
LONG(0xef0d8 - code32init_start)
LONG(0xef10a - code32init_start)
LONG(0xef110 - code32init_start)
LONG(0xef1f0 - code32init_start)
LONG(0xef1f6 - code32init_start)
LONG(0xef426 - code32init_start)
LONG(0xef4cf - code32init_start)
LONG(0xef69e - code32init_start)
LONG(0xef747 - code32init_start)
LONG(0xef7fa - code32init_start)
LONG(0xef954 - code32init_start)
LONG(0xef95a - code32init_start)
LONG(0xef9a1 - code32init_start)
LONG(0xefa04 - code32init_start)
LONG(0xefa21 - code32init_start)
LONG(0xefae6 - code32init_start)
LONG(0xefb44 - code32init_start)
LONG(0xefba4 - code32init_start)
LONG(0xefbf5 - code32init_start)
LONG(0xefc14 - code32init_start)
LONG(0xefc95 - code32init_start)
LONG(0xefdf7 - code32init_start)
LONG(0xefe1d - code32init_start)
LONG(0xefebb - code32init_start)
LONG(0xefec0 - code32init_start)
LONG(0xeff56 - code32init_start)
LONG(0xf0011 - code32init_start)
LONG(0xf001a - code32init_start)
LONG(0xf0095 - code32init_start)
LONG(0xf00ae - code32init_start)
LONG(0xf00c2 - code32init_start)
LONG(0xf00d6 - code32init_start)
LONG(0xf00ec - code32init_start)
LONG(0xf01ba - code32init_start)
LONG(0xf01c8 - code32init_start)
LONG(0xf01cc - code32init_start)
LONG(0xf01d0 - code32init_start)
LONG(0xf01d4 - code32init_start)
LONG(0xf01d8 - code32init_start)
LONG(0xf021c - code32init_start)
LONG(0xf0230 - code32init_start)
LONG(0xf0294 - code32init_start)
LONG(0xf02a8 - code32init_start)
LONG(0xf02bc - code32init_start)
LONG(0xf02d0 - code32init_start)
LONG(0xf02e4 - code32init_start)
LONG(0xf02f8 - code32init_start)
LONG(0xf030c - code32init_start)
LONG(0xf0334 - code32init_start)
LONG(0xf0424 - code32init_start)
LONG(0xf0578 - code32init_start)
LONG(0xf058c - code32init_start)
LONG(0xf2f88 - code32init_start)
LONG(0xf2f8c - code32init_start)
LONG(0xf2f90 - code32init_start)
LONG(0xf2f94 - code32init_start)
LONG(0xf2f98 - code32init_start)
LONG(0xf2f9c - code32init_start)
LONG(0xf2fa0 - code32init_start)
LONG(0xf2fa4 - code32init_start)
LONG(0xf2fa8 - code32init_start)
LONG(0xf2fac - code32init_start)
LONG(0xf2fb0 - code32init_start)
LONG(0xf2fb4 - code32init_start)
        _reloc_abs_end = ABSOLUTE(.) ;
        _reloc_rel_start = ABSOLUTE(.) ;
LONG(0xe4063 - code32init_start)
LONG(0xe4143 - code32init_start)
LONG(0xe4160 - code32init_start)
LONG(0xe4200 - code32init_start)
LONG(0xe4211 - code32init_start)
LONG(0xe4222 - code32init_start)
LONG(0xe4233 - code32init_start)
LONG(0xe4245 - code32init_start)
LONG(0xe482d - code32init_start)
LONG(0xe4bfa - code32init_start)
LONG(0xe4c2d - code32init_start)
LONG(0xe4c58 - code32init_start)
LONG(0xe4c78 - code32init_start)
LONG(0xe4c8f - code32init_start)
LONG(0xe4c9d - code32init_start)
LONG(0xe4ca6 - code32init_start)
LONG(0xe4cb7 - code32init_start)
LONG(0xe4cda - code32init_start)
LONG(0xe4d00 - code32init_start)
LONG(0xe4d0c - code32init_start)
LONG(0xe4d27 - code32init_start)
LONG(0xe4d37 - code32init_start)
LONG(0xe4d49 - code32init_start)
LONG(0xe4d55 - code32init_start)
LONG(0xe4d78 - code32init_start)
LONG(0xe4d89 - code32init_start)
LONG(0xe4d9e - code32init_start)
LONG(0xe4daa - code32init_start)
LONG(0xe4dbf - code32init_start)
LONG(0xe4ded - code32init_start)
LONG(0xe4e0a - code32init_start)
LONG(0xe4e1b - code32init_start)
LONG(0xe4e26 - code32init_start)
LONG(0xe4e77 - code32init_start)
LONG(0xe4ec5 - code32init_start)
LONG(0xe4f35 - code32init_start)
LONG(0xe4ff3 - code32init_start)
LONG(0xe501a - code32init_start)
LONG(0xe5039 - code32init_start)
LONG(0xe50b3 - code32init_start)
LONG(0xe50c1 - code32init_start)
LONG(0xe5173 - code32init_start)
LONG(0xe51c2 - code32init_start)
LONG(0xe5248 - code32init_start)
LONG(0xe5656 - code32init_start)
LONG(0xe5ec7 - code32init_start)
LONG(0xe5f55 - code32init_start)
LONG(0xe5fea - code32init_start)
LONG(0xe605f - code32init_start)
LONG(0xe607a - code32init_start)
LONG(0xe60b1 - code32init_start)
LONG(0xe611f - code32init_start)
LONG(0xe6126 - code32init_start)
LONG(0xe615f - code32init_start)
LONG(0xe618d - code32init_start)
LONG(0xe6192 - code32init_start)
LONG(0xe61a6 - code32init_start)
LONG(0xe6238 - code32init_start)
LONG(0xe6260 - code32init_start)
LONG(0xe6295 - code32init_start)
LONG(0xe62b8 - code32init_start)
LONG(0xe6347 - code32init_start)
LONG(0xe63b4 - code32init_start)
LONG(0xe6440 - code32init_start)
LONG(0xe6463 - code32init_start)
LONG(0xe647f - code32init_start)
LONG(0xe6498 - code32init_start)
LONG(0xe64bf - code32init_start)
LONG(0xe64ca - code32init_start)
LONG(0xe64db - code32init_start)
LONG(0xe6ac4 - code32init_start)
LONG(0xe6af0 - code32init_start)
LONG(0xe6b33 - code32init_start)
LONG(0xe6b46 - code32init_start)
LONG(0xe6b73 - code32init_start)
LONG(0xe6b88 - code32init_start)
LONG(0xe6edf - code32init_start)
LONG(0xe6ee4 - code32init_start)
LONG(0xe6f4f - code32init_start)
LONG(0xe6f67 - code32init_start)
LONG(0xe6ff5 - code32init_start)
LONG(0xe709c - code32init_start)
LONG(0xe70ae - code32init_start)
LONG(0xe717f - code32init_start)
LONG(0xe7189 - code32init_start)
LONG(0xe74f4 - code32init_start)
LONG(0xe762a - code32init_start)
LONG(0xe7634 - code32init_start)
LONG(0xe782f - code32init_start)
LONG(0xe793f - code32init_start)
LONG(0xe797c - code32init_start)
LONG(0xe7994 - code32init_start)
LONG(0xe79a5 - code32init_start)
LONG(0xe79dc - code32init_start)
LONG(0xe79ed - code32init_start)
LONG(0xe7a73 - code32init_start)
LONG(0xe7add - code32init_start)
LONG(0xe7b16 - code32init_start)
LONG(0xe7b48 - code32init_start)
LONG(0xe7bbf - code32init_start)
LONG(0xe7bf4 - code32init_start)
LONG(0xe7db2 - code32init_start)
LONG(0xe7dd0 - code32init_start)
LONG(0xe7dfd - code32init_start)
LONG(0xe7e04 - code32init_start)
LONG(0xe800c - code32init_start)
LONG(0xe8025 - code32init_start)
LONG(0xe8047 - code32init_start)
LONG(0xe8060 - code32init_start)
LONG(0xe808b - code32init_start)
LONG(0xe80d0 - code32init_start)
LONG(0xe8187 - code32init_start)
LONG(0xe819c - code32init_start)
LONG(0xe81aa - code32init_start)
LONG(0xe81e5 - code32init_start)
LONG(0xe826a - code32init_start)
LONG(0xe8283 - code32init_start)
LONG(0xe8407 - code32init_start)
LONG(0xe8415 - code32init_start)
LONG(0xe8427 - code32init_start)
LONG(0xe8469 - code32init_start)
LONG(0xe84ef - code32init_start)
LONG(0xe8654 - code32init_start)
LONG(0xe8752 - code32init_start)
LONG(0xe8759 - code32init_start)
LONG(0xe8776 - code32init_start)
LONG(0xe87c9 - code32init_start)
LONG(0xe89d3 - code32init_start)
LONG(0xe8a18 - code32init_start)
LONG(0xe8a28 - code32init_start)
LONG(0xe8a35 - code32init_start)
LONG(0xe8b9b - code32init_start)
LONG(0xe8ba5 - code32init_start)
LONG(0xe8ca7 - code32init_start)
LONG(0xe8cf2 - code32init_start)
LONG(0xe8d6a - code32init_start)
LONG(0xe8d74 - code32init_start)
LONG(0xe8d9d - code32init_start)
LONG(0xe8dde - code32init_start)
LONG(0xe8e14 - code32init_start)
LONG(0xe8e42 - code32init_start)
LONG(0xe8e95 - code32init_start)
LONG(0xe8f31 - code32init_start)
LONG(0xe8f63 - code32init_start)
LONG(0xe8ffb - code32init_start)
LONG(0xe911f - code32init_start)
LONG(0xe918f - code32init_start)
LONG(0xe91ee - code32init_start)
LONG(0xe920c - code32init_start)
LONG(0xe92ab - code32init_start)
LONG(0xe9312 - code32init_start)
LONG(0xe93c6 - code32init_start)
LONG(0xe95b0 - code32init_start)
LONG(0xe963b - code32init_start)
LONG(0xe9657 - code32init_start)
LONG(0xe9694 - code32init_start)
LONG(0xe96c4 - code32init_start)
LONG(0xe96e7 - code32init_start)
LONG(0xe97bd - code32init_start)
LONG(0xe9810 - code32init_start)
LONG(0xe9928 - code32init_start)
LONG(0xe9a14 - code32init_start)
LONG(0xe9a53 - code32init_start)
LONG(0xe9ab5 - code32init_start)
LONG(0xe9acc - code32init_start)
LONG(0xe9ad9 - code32init_start)
LONG(0xe9b10 - code32init_start)
LONG(0xe9b4e - code32init_start)
LONG(0xe9c65 - code32init_start)
LONG(0xe9dee - code32init_start)
LONG(0xe9f02 - code32init_start)
LONG(0xe9f6d - code32init_start)
LONG(0xea1cc - code32init_start)
LONG(0xea53f - code32init_start)
LONG(0xea598 - code32init_start)
LONG(0xea6b5 - code32init_start)
LONG(0xea76d - code32init_start)
LONG(0xea81b - code32init_start)
LONG(0xea86d - code32init_start)
LONG(0xea89e - code32init_start)
LONG(0xea8db - code32init_start)
LONG(0xea91d - code32init_start)
LONG(0xeaa6e - code32init_start)
LONG(0xeab13 - code32init_start)
LONG(0xeab2c - code32init_start)
LONG(0xeabd9 - code32init_start)
LONG(0xeac22 - code32init_start)
LONG(0xeb3af - code32init_start)
LONG(0xeb416 - code32init_start)
LONG(0xeb623 - code32init_start)
LONG(0xeb82e - code32init_start)
LONG(0xeb9ff - code32init_start)
LONG(0xeba1c - code32init_start)
LONG(0xeba7c - code32init_start)
LONG(0xebba5 - code32init_start)
LONG(0xebbaa - code32init_start)
LONG(0xebbc2 - code32init_start)
LONG(0xec06f - code32init_start)
LONG(0xec0c8 - code32init_start)
LONG(0xec0e0 - code32init_start)
LONG(0xec149 - code32init_start)
LONG(0xec14e - code32init_start)
LONG(0xec165 - code32init_start)
LONG(0xed201 - code32init_start)
LONG(0xed206 - code32init_start)
LONG(0xed21d - code32init_start)
LONG(0xed2bd - code32init_start)
LONG(0xed2f4 - code32init_start)
LONG(0xed31c - code32init_start)
LONG(0xed39a - code32init_start)
LONG(0xed630 - code32init_start)
LONG(0xed6df - code32init_start)
LONG(0xed776 - code32init_start)
LONG(0xed7c9 - code32init_start)
LONG(0xed7ff - code32init_start)
LONG(0xedc44 - code32init_start)
LONG(0xedcca - code32init_start)
LONG(0xedf45 - code32init_start)
LONG(0xedf64 - code32init_start)
LONG(0xedf90 - code32init_start)
LONG(0xedfa1 - code32init_start)
LONG(0xee07b - code32init_start)
LONG(0xee087 - code32init_start)
LONG(0xee0e1 - code32init_start)
LONG(0xee0ef - code32init_start)
LONG(0xee107 - code32init_start)
LONG(0xee12f - code32init_start)
LONG(0xee13d - code32init_start)
LONG(0xee15e - code32init_start)
LONG(0xee183 - code32init_start)
LONG(0xee2d6 - code32init_start)
LONG(0xee397 - code32init_start)
LONG(0xee417 - code32init_start)
LONG(0xee436 - code32init_start)
LONG(0xee468 - code32init_start)
LONG(0xee49b - code32init_start)
LONG(0xee4f5 - code32init_start)
LONG(0xee71d - code32init_start)
LONG(0xee734 - code32init_start)
LONG(0xee8c8 - code32init_start)
LONG(0xee959 - code32init_start)
LONG(0xee97c - code32init_start)
LONG(0xef4b7 - code32init_start)
LONG(0xef4c6 - code32init_start)
LONG(0xef4eb - code32init_start)
LONG(0xef505 - code32init_start)
LONG(0xef585 - code32init_start)
LONG(0xef59e - code32init_start)
LONG(0xef65f - code32init_start)
LONG(0xef677 - code32init_start)
LONG(0xef701 - code32init_start)
LONG(0xef86c - code32init_start)
LONG(0xef8ce - code32init_start)
LONG(0xef9a6 - code32init_start)
LONG(0xefa4c - code32init_start)
LONG(0xefa5b - code32init_start)
LONG(0xefa8c - code32init_start)
LONG(0xefce2 - code32init_start)
LONG(0xefcf7 - code32init_start)
LONG(0xefd98 - code32init_start)
LONG(0xefdba - code32init_start)
LONG(0xefdc7 - code32init_start)
LONG(0xefdcc - code32init_start)
LONG(0xefde0 - code32init_start)
LONG(0xeffe2 - code32init_start)
LONG(0xf0033 - code32init_start)
LONG(0xf013e - code32init_start)
LONG(0xf015a - code32init_start)
        _reloc_rel_end = ABSOLUTE(.) ;
        _reloc_init_start = ABSOLUTE(.) ;
LONG(0xf4f12 - code32flat_start)
LONG(0xfc7c1 - code32flat_start)
        _reloc_init_end = ABSOLUTE(.) ;

        code32init_start = ABSOLUTE(.) ;
. = ( 0xe3e40 - code32flat_start ) ;
*(.text.enable_hwirq)
. = ( 0xe3e7a - code32flat_start ) ;
*(.text.allocSpace)
. = ( 0xe3eca - code32flat_start ) ;
*(.text.freeSpace)
. = ( 0xe3ee9 - code32flat_start ) ;
*(.text.pmm_free)
. = ( 0xe3f2d - code32flat_start ) ;
*(.text.free)
. = ( 0xe3f32 - code32flat_start ) ;
*(.text.pmm_getspace)
. = ( 0xe3f69 - code32flat_start ) ;
*(.text.strlen)
. = ( 0xe3f78 - code32flat_start ) ;
*(.text.strtcpy)
. = ( 0xe3f9d - code32flat_start ) ;
*(.text.nullTrailingSpace)
. = ( 0xe3fba - code32flat_start ) ;
*(.text.ata_extract_version)
. = ( 0xe3fd6 - code32flat_start ) ;
*(.text.found_compatibleahci)
. = ( 0xe3fd7 - code32flat_start ) ;
*(.text.pci_config_writew)
. = ( 0xe4004 - code32flat_start ) ;
*(.text.findEndPointDesc)
. = ( 0xe404b - code32flat_start ) ;
*(.text.uhci_hub_reset)
. = ( 0xe4088 - code32flat_start ) ;
*(.text.uhci_hub_disconnect)
. = ( 0xe4097 - code32flat_start ) ;
*(.text.ohci_hub_detect)
. = ( 0xe40aa - code32flat_start ) ;
*(.text.ohci_hub_disconnect)
. = ( 0xe40b9 - code32flat_start ) ;
*(.text.ehci_hub_disconnect)
. = ( 0xe40c5 - code32flat_start ) ;
*(.text.piix4_fadt_init)
. = ( 0xe40d9 - code32flat_start ) ;
*(.text.getHex)
. = ( 0xe40ea - code32flat_start ) ;
*(.text.encodeLen)
. = ( 0xe4128 - code32flat_start ) ;
*(.text.pci_set_io_region_addr)
. = ( 0xe4164 - code32flat_start ) ;
*(.text.storage_ide_init)
. = ( 0xe41aa - code32flat_start ) ;
*(.text.piix_ide_init)
. = ( 0xe41d1 - code32flat_start ) ;
*(.text.pic_ibm_init)
. = ( 0xe41e0 - code32flat_start ) ;
*(.text.apple_macio_init)
. = ( 0xe41ef - code32flat_start ) ;
*(.text.piix4_pm_init)
. = ( 0xe4249 - code32flat_start ) ;
*(.text.pci_bios_bus_reserve)
. = ( 0xe4294 - code32flat_start ) ;
*(.text.idct)
. = ( 0xe45a9 - code32flat_start ) ;
*(.text.unlikely.idctqtab)
. = ( 0xe4606 - code32flat_start ) ;
*(.text.qemu_cfg_skip)
. = ( 0xe4617 - code32flat_start ) ;
*(.text.qemu_cfg_smbios_load_field)
. = ( 0xe46d2 - code32flat_start ) ;
*(.text.memmove)
. = ( 0xe4705 - code32flat_start ) ;
*(.text.remove_e820)
. = ( 0xe4730 - code32flat_start ) ;
*(.text.__qemu_cfg_set_file)
. = ( 0xe47a3 - code32flat_start ) ;
*(.text.qemu_cfg_size_file)
. = ( 0xe47ba - code32flat_start ) ;
*(.text.romfile_copy)
. = ( 0xe47ff - code32flat_start ) ;
*(.text.snprintf)
. = ( 0xe484a - code32flat_start ) ;
*(.text.smbios_init_type_4)
. = ( 0xe4a50 - code32flat_start ) ;
*(.text.smbios_init_type_17)
. = ( 0xe4bba - code32flat_start ) ;
*(.text.piix_isa_bridge_init)
. = ( 0xe4c39 - code32flat_start ) ;
*(.text.pci_bios_init_bus_rec)
. = ( 0xe4e41 - code32flat_start ) ;
*(.text.pci_bios_init_bus_bases)
. = ( 0xe4eef - code32flat_start ) ;
*(.text.pci_bios_map_device_in_bus)
. = ( 0xe51ad - code32flat_start ) ;
*(.text.find_prio)
. = ( 0xe5235 - code32flat_start ) ;
*(.text.__warn_noalloc)
. = ( 0xe5250 - code32flat_start ) ;
*(.text.qemu_cfg_smbios_load_external)
. = ( 0xe542e - code32flat_start ) ;
*(.text.addSpace)
. = ( 0xe54fc - code32flat_start ) ;
*(.text.pmm_malloc)
. = ( 0xe56d8 - code32flat_start ) ;
*(.text.malloc_tmphigh)
. = ( 0xe56f2 - code32flat_start ) ;
*(.text.memalign_high)
. = ( 0xe5708 - code32flat_start ) ;
*(.text.malloc_fseg)
. = ( 0xe5722 - code32flat_start ) ;
*(.text.malloc_high)
. = ( 0xe573c - code32flat_start ) ;
*(.text.alloc_default_control_pipe)
. = ( 0xe5872 - code32flat_start ) ;
*(.text.run_thread)
. = ( 0xe58f7 - code32flat_start ) ;
*(.text.memalign_low)
. = ( 0xe590d - code32flat_start ) ;
*(.text.malloc_low)
. = ( 0xe5927 - code32flat_start ) ;
*(.text.alloc_intr_pipe)
. = ( 0xe5ea0 - code32flat_start ) ;
*(.text.__end_thread)
. = ( 0xe5ecd - code32flat_start ) ;
*(.text.alloc_bulk_pipe)
. = ( 0xe5fc8 - code32flat_start ) ;
*(.text.msleep)
. = ( 0xe6008 - code32flat_start ) ;
*(.text.uhci_hub_detect)
. = ( 0xe6031 - code32flat_start ) ;
*(.text.iomemcpy)
. = ( 0xe6077 - code32flat_start ) ;
*(.text.wait_threads)
. = ( 0xe608b - code32flat_start ) ;
*(.text.usb_enumerate)
. = ( 0xe60bf - code32flat_start ) ;
*(.text.ahci_port_reset)
. = ( 0xe6154 - code32flat_start ) ;
*(.text.enable_vga_console)
. = ( 0xe61ae - code32flat_start ) ;
*(.text.get_keystroke)
. = ( 0xe62cf - code32flat_start ) ;
*(.text.putc_str)
. = ( 0xe62dd - code32flat_start ) ;
*(.text.add_bev)
. = ( 0xe6330 - code32flat_start ) ;
*(.text.pci_bios_check_device_in_bus)
. = ( 0xe654b - code32flat_start ) ;
*(.text.getword.isra.18)
. = ( 0xe6568 - code32flat_start ) ;
*(.text.readtables)
. = ( 0xe6940 - code32flat_start ) ;
*(.text.fillbits)
. = ( 0xe69bd - code32flat_start ) ;
*(.text.dec_rec2)
. = ( 0xe6aba - code32flat_start ) ;
*(.text.init_optionrom)
. = ( 0xe6b15 - code32flat_start ) ;
*(.text.__i8042_command)
. = ( 0xe6baa - code32flat_start ) ;
*(.text.insert_e820)
. = ( 0xe6c23 - code32flat_start ) ;
*(.text.add_e820)
. = ( 0xe6e1e - code32flat_start ) ;
*(.text.wrmsr_smp)
. = ( 0xe6e65 - code32flat_start ) ;
*(.text.add_drive)
. = ( 0xe6e87 - code32flat_start ) ;
*(.text.ohci_waittick.isra.36)
. = ( 0xe6ef0 - code32flat_start ) ;
*(.text.ohci_hub_reset)
. = ( 0xe6f89 - code32flat_start ) ;
*(.text.free_pipe)
. = ( 0xe70c6 - code32flat_start ) ;
*(.text.configure_ehci)
. = ( 0xe72a9 - code32flat_start ) ;
*(.text.configure_uhci)
. = ( 0xe740c - code32flat_start ) ;
*(.text.configure_ohci)
. = ( 0xe75f0 - code32flat_start ) ;
*(.text.powerup_await_non_bsy)
. = ( 0xe7647 - code32flat_start ) ;
*(.text.init_atadrive)
. = ( 0xe76a3 - code32flat_start ) ;
*(.text.malloc_tmp)
. = ( 0xe76ca - code32flat_start ) ;
*(.text.bootentry_add)
. = ( 0xe775d - code32flat_start ) ;
*(.text.boot_add_cd)
. = ( 0xe7782 - code32flat_start ) ;
*(.text.boot_add_hd)
. = ( 0xe77a7 - code32flat_start ) ;
*(.text.boot_add_bcv)
. = ( 0xe77e6 - code32flat_start ) ;
*(.text.znprintf)
. = ( 0xe784d - code32flat_start ) ;
*(.text.memalign_tmp)
. = ( 0xe7882 - code32flat_start ) ;
*(.text.bounce_buf_init)
. = ( 0xe78b6 - code32flat_start ) ;
*(.text.init_controller.constprop.62)
. = ( 0xe795d - code32flat_start ) ;
*(.text.found_genericata)
. = ( 0xe7a1f - code32flat_start ) ;
*(.text.detect_serial.constprop.64)
. = ( 0xe7a67 - code32flat_start ) ;
*(.text.pci_config_maskw.constprop.65)
. = ( 0xe7a8a - code32flat_start ) ;
*(.text.uhci_init)
. = ( 0xe7b6e - code32flat_start ) ;
*(.text.ohci_init)
. = ( 0xe7c27 - code32flat_start ) ;
*(.text.ehci_note_port.part.56)
. = ( 0xe7c71 - code32flat_start ) ;
*(.text.ehci_hub_reset)
. = ( 0xe7cd0 - code32flat_start ) ;
*(.text.ehci_hub_detect)
. = ( 0xe7d61 - code32flat_start ) ;
*(.text.ps2_recvbyte.constprop.66)
. = ( 0xe7e1a - code32flat_start ) ;
*(.text.__cfg_next_prefix_file.part.23)
. = ( 0xe7e96 - code32flat_start ) ;
*(.text.romfile_find)
. = ( 0xe7eb8 - code32flat_start ) ;
*(.text.romfile_loadint)
. = ( 0xe7f24 - code32flat_start ) ;
*(.text.pci_probe_devices)
. = ( 0xe80df - code32flat_start ) ;
*(.text.init_pcirom)
. = ( 0xe82c3 - code32flat_start ) ;
*(.text.romfile_loadfile)
. = ( 0xe831d - code32flat_start ) ;
*(.text.run_file_roms)
. = ( 0xe839f - code32flat_start ) ;
*(.text.send_ata_identity)
. = ( 0xe843b - code32flat_start ) ;
*(.text.ata_extract_model.constprop.70)
. = ( 0xe8460 - code32flat_start ) ;
*(.text.ps2_sendbyte.constprop.72)
. = ( 0xe849c - code32flat_start ) ;
*(.text.__ps2_command.constprop.73)
. = ( 0xe863e - code32flat_start ) ;
*(.text.keyboard_init)
. = ( 0xe87d3 - code32flat_start ) ;
*(.text.send_default_control)
. = ( 0xe8db2 - code32flat_start ) ;
*(.text.usb_hub_disconnect)
. = ( 0xe8e1e - code32flat_start ) ;
*(.text.set_port_feature)
. = ( 0xe8e6b - code32flat_start ) ;
*(.text.get_port_status)
. = ( 0xe8ec1 - code32flat_start ) ;
*(.text.usb_hub_reset)
. = ( 0xe8f79 - code32flat_start ) ;
*(.text.usb_hub_detect)
. = ( 0xe900e - code32flat_start ) ;
*(.text.build_pci_path.constprop.79)
. = ( 0xe90eb - code32flat_start ) ;
*(.text.init_virtio_blk)
. = ( 0xe93a7 - code32flat_start ) ;
*(.text.addFloppy)
. = ( 0xe94d9 - code32flat_start ) ;
*(.text.bootprio_find_ata_device)
. = ( 0xe9537 - code32flat_start ) ;
*(.text.ata_detect)
. = ( 0xe998c - code32flat_start ) ;
*(.text.ahci_port_init)
. = ( 0xe9cd2 - code32flat_start ) ;
*(.text.ahci_port_detect)
. = ( 0xe9e18 - code32flat_start ) ;
*(.text.getRomPriority)
. = ( 0xe9ee3 - code32flat_start ) ;
*(.text.optionrom_setup)
. = ( 0xea0c0 - code32flat_start ) ;
*(.text.bootprio_find_usb)
. = ( 0xea168 - code32flat_start ) ;
*(.text.setup_drive_cdrom.isra.55)
. = ( 0xea1a7 - code32flat_start ) ;
*(.text.usb_init_hub_port)
. = ( 0xeaad4 - code32flat_start ) ;
*(.text.build_header.constprop.80)
. = ( 0xeab1c - code32flat_start ) ;
*(.text.acpi_bios_init)
. = ( 0xeba2b - code32flat_start ) ;
*(.text.boot_prep)
. = ( 0xed7e4 - code32flat_start ) ;
*(.text.init.out/../src/pmm.c.546)
. = ( 0xed952 - code32flat_start ) ;
*(.text.maininit)
. = ( 0xefde4 - code32flat_start ) ;
*(.text.init.out/../src/post.c.337)
. = ( 0xf01c8 - code32flat_start ) ;
*(.rodata.Zones)
. = ( 0xf01dc - code32flat_start ) ;
*(.rodata.__func__.2023)
. = ( 0xf01e8 - code32flat_start ) ;
*(.rodata.__func__.7382)
. = ( 0xf01f4 - code32flat_start ) ;
*(.rodata.__func__.4476)
. = ( 0xf0200 - code32flat_start ) ;
*(.rodata.__func__.4690)
. = ( 0xf020c - code32flat_start ) ;
*(.rodata.pci_isa_bridge_tbl)
. = ( 0xf0248 - code32flat_start ) ;
*(.rodata.pci_irqs)
. = ( 0xf024c - code32flat_start ) ;
*(.rodata.__func__.8533)
. = ( 0xf0264 - code32flat_start ) ;
*(.rodata.__func__.4030)
. = ( 0xf0278 - code32flat_start ) ;
*(.rodata.region_type_name)
. = ( 0xf0284 - code32flat_start ) ;
*(.rodata.pci_class_tbl)
. = ( 0xf0324 - code32flat_start ) ;
*(.rodata.pci_device_tbl)
. = ( 0xf034c - code32flat_start ) ;
*(.rodata.__func__.7673)
. = ( 0xf035c - code32flat_start ) ;
*(.rodata.__func__.9750)
. = ( 0xf0370 - code32flat_start ) ;
*(.rodata.__func__.8257)
. = ( 0xf0380 - code32flat_start ) ;
*(.rodata.__func__.8390)
. = ( 0xf038c - code32flat_start ) ;
*(.rodata.__func__.9679)
. = ( 0xf03ac - code32flat_start ) ;
*(.rodata.__func__.8311)
. = ( 0xf03c4 - code32flat_start ) ;
*(.rodata.acpi_find_tbl)
. = ( 0xf03ec - code32flat_start ) ;
*(.rodata.__func__.8159)
. = ( 0xf03f8 - code32flat_start ) ;
*(.rodata.__func__.8210)
. = ( 0xf0408 - code32flat_start ) ;
*(.rodata.__func__.8065)
. = ( 0xf0414 - code32flat_start ) ;
*(.rodata.fadt_init_tbl)
. = ( 0xf043c - code32flat_start ) ;
*(.rodata.__func__.8105)
. = ( 0xf0448 - code32flat_start ) ;
*(.rodata.ssdt_proc)
. = ( 0xf049c - code32flat_start ) ;
*(.rodata.__func__.8072)
. = ( 0xf04a8 - code32flat_start ) ;
*(.rodata.__func__.8172)
. = ( 0xf04b4 - code32flat_start ) ;
*(.rodata.__FUNCTION__.8191)
. = ( 0xf04c0 - code32flat_start ) ;
*(.rodata.__func__.8141)
. = ( 0xf04d0 - code32flat_start ) ;
*(.rodata.__FUNCTION__.8127)
. = ( 0xf04e0 - code32flat_start ) ;
*(.rodata.ssdt_mem)
. = ( 0xf055c - code32flat_start ) ;
*(.rodata.__func__.8742)
. = ( 0xf0568 - code32flat_start ) ;
*(.rodata.pci_ata_tbl)
. = ( 0xf05a4 - code32flat_start ) ;
*(.rodata.__func__.4558)
. = ( 0xf05b0 - code32flat_start ) ;
*(.rodata.__func__.4663)
. = ( 0xf05c0 - code32flat_start ) ;
*(.rodata.__func__.4600)
. = ( 0xf05d0 - code32flat_start ) ;
*(.rodata.__func__.4539)
. = ( 0xf05e0 - code32flat_start ) ;
*(.rodata.__func__.6039)
. = ( 0xf05ec - code32flat_start ) ;
*(.rodata.__func__.6018)
. = ( 0xf05fc - code32flat_start ) ;
*(.rodata.__func__.5671)
. = ( 0xf060c - code32flat_start ) ;
*(.rodata.__func__.5612)
. = ( 0xf0614 - code32flat_start ) ;
*(.rodata.__func__.5895)
. = ( 0xf0624 - code32flat_start ) ;
*(.rodata.__func__.5845)
. = ( 0xf062c - code32flat_start ) ;
*(.rodata.__func__.5854)
. = ( 0xf063c - code32flat_start ) ;
*(.rodata.__func__.6111)
. = ( 0xf064c - code32flat_start ) ;
*(.rodata.__func__.6048)
. = ( 0xf065c - code32flat_start ) ;
*(.rodata.__func__.5650)
. = ( 0xf0674 - code32flat_start ) ;
*(.rodata.__func__.5886)
. = ( 0xf068c - code32flat_start ) ;
*(.rodata.__func__.6088)
. = ( 0xf06a4 - code32flat_start ) ;
*(.rodata.__func__.9573)
. = ( 0xf06b4 - code32flat_start ) ;
*(.rodata.__func__.6404)
. = ( 0xf06c4 - code32flat_start ) ;
*(.rodata.__func__.5686)
. = ( 0xf06dc - code32flat_start ) ;
*(.rodata.__func__.6130)
. = ( 0xf06f4 - code32flat_start ) ;
*(.rodata.__func__.7776)
. = ( 0xf0704 - code32flat_start ) ;
*(.rodata.__func__.2376)
. = ( 0xf0710 - code32flat_start ) ;
*(.rodata.__func__.5741)
. = ( 0xf0728 - code32flat_start ) ;
*(.rodata.__func__.6183)
. = ( 0xf0740 - code32flat_start ) ;
*(.rodata.__func__.6079)
. = ( 0xf0750 - code32flat_start ) ;
*(.rodata.__func__.5640)
. = ( 0xf0760 - code32flat_start ) ;
*(.rodata.__func__.5877)
. = ( 0xf0770 - code32flat_start ) ;
*(.rodata.__func__.5606)
. = ( 0xf077c - code32flat_start ) ;
*(.rodata.__func__.5593)
. = ( 0xf078c - code32flat_start ) ;
*(.rodata.__func__.5838)
. = ( 0xf0798 - code32flat_start ) ;
*(.rodata.__func__.5824)
. = ( 0xf07a8 - code32flat_start ) ;
*(.rodata.__func__.5794)
. = ( 0xf07b8 - code32flat_start ) ;
*(.rodata.__func__.5811)
. = ( 0xf07c4 - code32flat_start ) ;
*(.rodata.__func__.3033)
. = ( 0xf07d0 - code32flat_start ) ;
*(.rodata.__func__.3519)
. = ( 0xf07e8 - code32flat_start ) ;
*(.rodata.__func__.3289)
. = ( 0xf07f4 - code32flat_start ) ;
*(.rodata.__func__.3489)
. = ( 0xf0804 - code32flat_start ) ;
*(.rodata.__func__.3552)
. = ( 0xf0814 - code32flat_start ) ;
*(.rodata.__func__.6915)
. = ( 0xf082c - code32flat_start ) ;
*(.rodata.__func__.6895)
. = ( 0xf083c - code32flat_start ) ;
*(.rodata.__func__.6863)
. = ( 0xf084c - code32flat_start ) ;
*(.rodata.__func__.6870)
. = ( 0xf085c - code32flat_start ) ;
*(.rodata.__func__.6618)
. = ( 0xf086c - code32flat_start ) ;
*(.rodata.__func__.9080)
. = ( 0xf0880 - code32flat_start ) ;
*(.rodata.zig)
. = ( 0xf08c0 - code32flat_start ) ;
*(.rodata.aaidct)
. = ( 0xf08e0 - code32flat_start ) ;
*(.rodata.__func__.2806)
. = ( 0xf08ec - code32flat_start ) ;
*(.rodata.__func__.2754)
. = ( 0xf08fc - code32flat_start ) ;
*(.data.DefaultBEVPrio)
. = ( 0xf0900 - code32flat_start ) ;
*(.data.DefaultHDPrio)
. = ( 0xf0904 - code32flat_start ) ;
*(.data.DefaultCDPrio)
. = ( 0xf0908 - code32flat_start ) ;
*(.data.DefaultFloppyPrio)
. = ( 0xf090c - code32flat_start ) ;
*(.data.AmlCode)
. = ( 0xf2f88 - code32flat_start ) ;
*(.data.ehci_HubOp)
. = ( 0xf2f94 - code32flat_start ) ;
*(.data.HubOp)
. = ( 0xf2fa0 - code32flat_start ) ;
*(.data.uhci_HubOp)
. = ( 0xf2fac - code32flat_start ) ;
*(.data.ohci_HubOp)
. = ( 0xf2fb8 - code32flat_start ) ;
*(.data.zig2)
. = ( 0xf2ff8 - code32flat_start ) ;
*(.bss.ZoneTmpLow)
. = ( 0xf2ffc - code32flat_start ) ;
*(.bss.ZoneLow)
. = ( 0xf3000 - code32flat_start ) ;
*(.bss.ZoneFSeg)
. = ( 0xf3004 - code32flat_start ) ;
*(.bss.ZoneTmpHigh)
. = ( 0xf3008 - code32flat_start ) ;
*(.bss.ZoneHigh)
. = ( 0xf300c - code32flat_start ) ;
*(.bss.qemu_cfg_present)
. = ( 0xf3010 - code32flat_start ) ;
*(.bss.RamSizeOver4G)
. = ( 0xf3018 - code32flat_start ) ;
*(.bss.CDCount)
. = ( 0xf301c - code32flat_start ) ;
*(.bss.busses_count)
. = ( 0xf3020 - code32flat_start ) ;
*(.bss.busses)
. = ( 0xf3024 - code32flat_start ) ;
*(.bss.LastFile)
. = ( 0xf3064 - code32flat_start ) ;
*(.bss.BootorderCount)
. = ( 0xf3068 - code32flat_start ) ;
*(.bss.Bootorder)
. = ( 0xf3070 - code32flat_start ) ;
*(.bss.used_bitmap.9672)
. = ( 0xf3090 - code32flat_start ) ;
*(.bss.SMBiosAddr)
. = ( 0xf3098 - code32flat_start ) ;
*(.bss.nb_hp_memslots)
. = ( 0xf30a0 - code32flat_start ) ;
*(.bss.mem)
. = ( 0xf30a8 - code32flat_start ) ;
*(.bss.SpinupEnd)
. = ( 0xf30b0 - code32flat_start ) ;
*(.bss.BootList)
. = ( 0xf30b4 - code32flat_start ) ;
*(.bss.chanid.3550)
. = ( 0xf30b8 - code32flat_start ) ;
*(.bss.BootsplashActive)
. = ( 0xf30bc - code32flat_start ) ;
*(.bss.HaveHDBoot)
. = ( 0xf30c0 - code32flat_start ) ;
*(.bss.HaveFDBoot)

        code32init_end = ABSOLUTE(.) ;
. = ( 0xf30d0 - code32flat_start ) ;
*(.text.asm.out/../src/smm.c.70)
. = ( 0xf311d - code32flat_start ) ;
*(.text.switch_next)
. = ( 0xf3138 - code32flat_start ) ;
*(.text.putc_debug)
. = ( 0xf3141 - code32flat_start ) ;
*(.text.putuint)
. = ( 0xf3187 - code32flat_start ) ;
*(.text.putsinglehex)
. = ( 0xf319c - code32flat_start ) ;
*(.text.bvprintf)
. = ( 0xf33d7 - code32flat_start ) ;
*(.text.checksum)
. = ( 0xf33ea - code32flat_start ) ;
*(.text.strcmp)
. = ( 0xf340a - code32flat_start ) ;
*(.text.pci_config_writel)
. = ( 0xf342d - code32flat_start ) ;
*(.text.pci_config_writeb)
. = ( 0xf3459 - code32flat_start ) ;
*(.text.pci_config_readl)
. = ( 0xf3478 - code32flat_start ) ;
*(.text.pci_config_readw)
. = ( 0xf34a3 - code32flat_start ) ;
*(.text.pci_config_readb)
. = ( 0xf34cd - code32flat_start ) ;
*(.text.pci_next)
. = ( 0xf3519 - code32flat_start ) ;
*(.text.pci_init_device)
. = ( 0xf3572 - code32flat_start ) ;
*(.text.tscdelay)
. = ( 0xf35a8 - code32flat_start ) ;
*(.text.udelay)
. = ( 0xf35bf - code32flat_start ) ;
*(.text.fillTDbuffer)
. = ( 0xf3624 - code32flat_start ) ;
*(.text.i440fx_bios_make_readonly)
. = ( 0xf368a - code32flat_start ) ;
*(.text.piix4_apmc_smm_init)
. = ( 0xf3776 - code32flat_start ) ;
*(.text.printf)
. = ( 0xf3789 - code32flat_start ) ;
*(.text.__dprintf)
. = ( 0xf379c - code32flat_start ) ;
*(.text.__warn_timeout)
. = ( 0xf37b7 - code32flat_start ) ;
*(.text.panic)
. = ( 0xf37cd - code32flat_start ) ;
*(.text.call16big)
. = ( 0xf37f1 - code32flat_start ) ;
*(.text.yield)
. = ( 0xf3838 - code32flat_start ) ;
*(.text.__callrom)
. = ( 0xf38b7 - code32flat_start ) ;
*(.text.unlikely.call_boot_entry)
. = ( 0xf3929 - code32flat_start ) ;
*(.text.__call16_int)
. = ( 0xf3957 - code32flat_start ) ;
*(.text.screenc)
. = ( 0xf398e - code32flat_start ) ;
*(.text.putc_screen)
. = ( 0xf39ba - code32flat_start ) ;
*(.text.__make_bios_writable_intel)
. = ( 0xf3a20 - code32flat_start ) ;
*(.text.make_bios_writable)
. = ( 0xf3a8f - code32flat_start ) ;
*(.text.is_valid_rom)
. = ( 0xf3aed - code32flat_start ) ;
*(.text.i8042_wait_write)
. = ( 0xf3b1e - code32flat_start ) ;
*(.text.ehci_wait_td.isra.32)
. = ( 0xf3b9a - code32flat_start ) ;
*(.text.ehci_waittick.isra.34)
. = ( 0xf3c3e - code32flat_start ) ;
*(.text.wait_td.isra.39)
. = ( 0xf3cc0 - code32flat_start ) ;
*(.text.uhci_waittick)
. = ( 0xf3d28 - code32flat_start ) ;
*(.text.usb_send_bulk)
. = ( 0xf3fef - code32flat_start ) ;
*(.text.unlikely.boot_disk)
. = ( 0xf4079 - code32flat_start ) ;
*(.text.pci_find_init_device.constprop.63)
. = ( 0xf40a0 - code32flat_start ) ;
*(.text.make_bios_readonly)
. = ( 0xf40bd - code32flat_start ) ;
*(.text.await_ide.constprop.68)
. = ( 0xf412e - code32flat_start ) ;
*(.text.await_not_bsy)
. = ( 0xf413c - code32flat_start ) ;
*(.text.ndelay_await_not_bsy)
. = ( 0xf4162 - code32flat_start ) ;
*(.text.ata_wait_data)
. = ( 0xf4181 - code32flat_start ) ;
*(.text.send_cmd)
. = ( 0xf4239 - code32flat_start ) ;
*(.text.ata_pio_transfer.constprop.69)
. = ( 0xf42e3 - code32flat_start ) ;
*(.text.__debug_enter.constprop.71)
. = ( 0xf4306 - code32flat_start ) ;
*(.text.ahci_command.constprop.78)
. = ( 0xf44a0 - code32flat_start ) ;
*(.text.cdb_cmd_data)
. = ( 0xf46ed - code32flat_start ) ;
*(.text.unlikely.cdb_read)
. = ( 0xf4726 - code32flat_start ) ;
*(.text.unlikely.cdrom_boot)
. = ( 0xf4b88 - code32flat_start ) ;
*(.text.do_boot)
. = ( 0xf4cd8 - code32flat_start ) ;
*(.text.runtime.out/../src/pci.c.235)
. = ( 0xf4cdb - code32flat_start ) ;
*(.text.runtime.out/../src/pci.c.258)
. = ( 0xf4ce3 - code32flat_start ) ;
*(.text.runtime.out/../src/resume.c.149)
. = ( 0xf4e97 - code32flat_start ) ;
*(.text.runtime.out/../src/post.c.196)
. = ( 0xf4ed3 - code32flat_start ) ;
*(.text.runtime.out/../src/post.c.354)
. = ( 0xf4f16 - code32flat_start ) ;
*(.text.runtime.out/../src/boot.c.643)
. = ( 0xf4f41 - code32flat_start ) ;
*(.text.runtime.out/../src/boot.c.655)
. = ( 0xf4f65 - code32flat_start ) ;
_rodata = . ;
*(.rodata.str1.1)
. = ( 0xf6428 - code32flat_start ) ;
*(.rodata.bvprintf)
. = ( 0xf6444 - code32flat_start ) ;
*(.rodata.smm_init_tbl)
. = ( 0xf646c - code32flat_start ) ;
*(.rodata.dram_controller_make_readonly_tbl)
. = ( 0xf6494 - code32flat_start ) ;
*(.rodata.__func__.4548)
. = ( 0xf64a8 - code32flat_start ) ;
*(.rodata.__func__.5621)
. = ( 0xf64b8 - code32flat_start ) ;
*(.rodata.__func__.6057)
. = ( 0xf64c8 - code32flat_start ) ;
*(.rodata.__func__.3263)
. = ( 0xf64d4 - code32flat_start ) ;
*(.rodata.__func__.5694)
. = ( 0xf64dc - code32flat_start ) ;
*(.rodata.__func__.6138)
. = ( 0xf64ec - code32flat_start ) ;
*(.rodata.__func__.6789)
. = ( 0xf64fc - code32flat_start ) ;
*(.rodata.__func__.7923)
. = ( 0xf6508 - code32flat_start ) ;
*(.rodata.__func__.7929)
. = ( 0xf6514 - code32flat_start ) ;
*(.rodata.VERSION)
. = ( 0xf6540 - code32flat_start ) ;
*(.data.runtime.out/../src/stacks.c.18)
. = ( 0xf654c - code32flat_start ) ;
*(.data.debuginfo)
. = ( 0xf6550 - code32flat_start ) ;
*(.data.RomEnd)
. = ( 0xf6554 - code32flat_start ) ;
*(.data.CheckFloppySig)
. = ( 0xf6558 - code32flat_start ) ;
*(.data.screeninfo)
. = ( 0xf655c - code32flat_start ) ;
*(.bss.RsdpAddr)
. = ( 0xf6560 - code32flat_start ) ;
*(.bss.S3ResumeVgaInit)
. = ( 0xf6564 - code32flat_start ) ;
*(.bss.PCIDevices)
. = ( 0xf6568 - code32flat_start ) ;
*(.bss.EnforceChecksum)
. = ( 0xf656c - code32flat_start ) ;
*(.bss.ScreenAndDebug)
. = ( 0xf6570 - code32flat_start ) ;
*(.bss.BEVCount)
. = ( 0xf6574 - code32flat_start ) ;
*(.bss.BEV)

        . = ( 0xf661b - code32flat_start ) ;
        *(.text32seg)
        . = ( 0xf6ba0 - code32flat_start ) ;
        *(.text16)
        code32flat_end = ABSOLUTE(.) ;
    } :text


        /* Discard regular data sections to force a link error if
         * code attempts to access data not marked with VAR16 (or other
         * appropriate macro)
         */
        /DISCARD/ : {
                *(.text*) *(.data*) *(.bss*) *(.rodata*)
                *(COMMON) *(.discard*) *(.eh_frame)
                }
}

ENTRY(entry_elf)
PHDRS
{
        text PT_LOAD AT ( code32flat_start ) ;
}
